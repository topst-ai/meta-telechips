## meta-core/conf/layer.conf
```bitbake
# We have a conf and classes directory, add to BBPATH
BBPATH .= ":${LAYERDIR}"

# We have a recipes directory containing .bb and .bbappend files, add to BBFILES
BBFILES += "${LAYERDIR}/recipes-*/*/*.bb \
            ${LAYERDIR}/recipes-*/*/*.bbappend"

BBFILE_COLLECTIONS += "telechips-core"
BBFILE_PATTERN_telechips-core = "^${LAYERDIR}/"
BBFILE_PRIORITY_telechips-core = "8"

# This should only be incremented on significant changes that will
# cause compatibility issues with other layers
LAYERVERSION_telechips-core = "2"
LAYERDEPENDS_telechips-core = "core"
LAYERSERIES_COMPAT_telechips-core = "zeus dunfell"

LICENSE_PATH += "${LAYERDIR}/licenses"
```

## meta-extra/conf/layer.conf
```bitbake
# We have a conf and classes directory, add to BBPATH
BBPATH .= ":${LAYERDIR}"

# We have a recipes directory containing .bb and .bbappend files, add to BBFILES
BBFILES += "${LAYERDIR}/recipes-*/*/*.bb \
            ${LAYERDIR}/recipes-*/*/*.bbappend"

BBFILE_COLLECTIONS += "telechips-extra"
BBFILE_PATTERN_telechips-extra = "^${LAYERDIR}/"
BBFILE_PRIORITY_telechips-extra = "8"

# This should only be incremented on significant changes that will
# cause compatibility issues with other layers
LAYERVERSION_telechips-extra = "2"
LAYERDEPENDS_telechips-extra = "core"
LAYERSERIES_COMPAT_telechips-extra = "zeus dunfell"

# ttf.inc inherits fontcache which adds fontconfig-utils to RDEPENDS
SIGGEN_EXCLUDE_SAFE_RECIPE_DEPS += " \
  terminus-font->fontconfig \
  ttf-abyssinica->fontconfig \
  ttf-arphic-uming->fontconfig \
  ttf-dejavu->fontconfig \
  ttf-droid->fontconfig \
  ttf-gentium->fontconfig \
  ttf-hunkyfonts->fontconfig \
  ttf-inconsolata->fontconfig \
  ttf-liberation->fontconfig \
  ttf-liberation-sans-narrow->fontconfig \
  ttf-lklug->fontconfig \
  ttf-lohit->fontconfig \
  ttf-noto-emoji->fontconfig \
  ttf-pt-sans->fontconfig \
  ttf-roboto->fontconfig \
  ttf-mplus->fontconfig \
  ttf-sazanami->fontconfig \
  ttf-tlwg->fontconfig \
  ttf-ubuntu-font-family->fontconfig \
  ttf-vlgothic->fontconfig \
  ttf-wqy-zenhei->fontconfig \
  source-han-sans-cn-fonts->fontconfig \
  source-han-sans-jp-fonts->fontconfig \
  source-han-sans-kr-fonts->fontconfig \
  source-han-sans-tw-fonts->fontconfig \
"
```

## meta-ivi/conf/layer.conf
```bitbake
# We have a conf and classes directory, add to BBPATH
BBPATH .= ":${LAYERDIR}"

# We have a recipes directory containing .bb and .bbappend files, add to BBFILES
BBFILES += "${LAYERDIR}/recipes-*/*/*.bb \
			${LAYERDIR}/recipes-*/*/*.bbappend"

BBFILE_COLLECTIONS += "telechips-ivi"
BBFILE_PATTERN_telechips-ivi = "^${LAYERDIR}/"
BBFILE_PRIORITY_telechips-ivi = "8"

# This should only be incremented on significant changes that will
# cause compatibility issues with other layers
LAYERVERSION_telechips-ivi = "2"

LAYERDEPENDS_telechips-ivi = "telechips-core"
RM_WORK_EXCLUDE += "automotive-linux-platform-image"

LAYERSERIES_COMPAT_telechips-ivi = "zeus dunfell"
```

## meta-ivi/meta-genivi/conf/layer.conf
```bitbake
# We have a conf and classes directory, add to BBPATH
BBPATH .= ":${LAYERDIR}"

# We have a recipes directory containing .bb and .bbappend files, add to BBFILES
BBFILES += "${LAYERDIR}/recipes-*/*/*.bb \
			${LAYERDIR}/recipes-*/*/*.bbappend"

BBFILE_COLLECTIONS += "telechips-genivi"
BBFILE_PATTERN_telechips-genivi = "^${LAYERDIR}/"
BBFILE_PRIORITY_telechips-genivi = "9"

# This should only be incremented on significant changes that will
# cause compatibility issues with other layers
LAYERVERSION_telechips-genivi = "2"

LAYERDEPENDS_telechips-genivi = "telechips-core telechips-ivi"
INVITE_PLATFORM_append = " genivi"

LAYERSERIES_COMPAT_telechips-genivi = "zeus dunfell"
```

## meta-micom/conf/layer.conf
```bitbake
# We have a conf and classes directory, add to BBPATH
BBPATH .= ":${LAYERDIR}"

# We have a recipes directory containing .bb and .bbappend files, add to BBFILES
BBFILES += "${LAYERDIR}/recipes-*/*/*.bb \
			${LAYERDIR}/recipes-*/*/*.bbappend"

BBFILE_COLLECTIONS += "telechips-micom"
BBFILE_PATTERN_telechips-micom = "^${LAYERDIR}/"
BBFILE_PRIORITY_telechips-micom = "8"


# This should only be incremented on significant changes that will
# cause compatibility issues with other layers
LAYERVERSION_telechips-micom = "2"
LAYERDEPENDS_telechips-micom = "telechips-core telechips-bsp"

LAYERSERIES_COMPAT_telechips-micom = "dunfell"

INVITE_PLATFORM_append = " micom"
```

## meta-qt5/conf/layer.conf
```bitbake
# We have a conf and classes directory, add to BBPATH
BBPATH .= ":${LAYERDIR}"

# We have a recipes directory containing .bb and .bbappend files, add to BBFILES
BBFILES += "${LAYERDIR}/recipes-*/*/*.bb \
			${LAYERDIR}/recipes-*/*/*.bbappend"

BBFILE_COLLECTIONS += "telechips-qt5"
BBFILE_PATTERN_telechips-qt5 = "^${LAYERDIR}/"
BBFILE_PRIORITY_telechips-qt5 = "8"

# This should only be incremented on significant changes that will
# cause compatibility issues with other layers
LAYERVERSION_telechips-qt5 = "2"

LAYERDEPENDS_telechips-qt5 = "core"
RM_WORK_EXCLUDE += "meta-toolchain-qt5"

LAYERSERIES_COMPAT_telechips-qt5 = "zeus dunfell"

INVITE_PLATFORM_append = "${@bb.utils.contains('DISTRO_FEATURES', 'wayland', ' qt5/wayland', ' qt5/eglfs', d)}"
```

## meta-subcore/conf/layer.conf
```bitbake
# We have a conf and classes directory, add to BBPATH
BBPATH .= ":${LAYERDIR}"

# We have a recipes directory containing .bb and .bbappend files, add to BBFILES
BBFILES += "${LAYERDIR}/recipes-*/*/*.bb \
			${LAYERDIR}/recipes-*/*/*.bbappend"

BBFILE_COLLECTIONS += "telechips-subcore"
BBFILE_PATTERN_telechips-subcore = "^${LAYERDIR}/"
BBFILE_PRIORITY_telechips-subcore = "9"

# This should only be incremented on significant changes that will
# cause compatibility issues with other layers
LAYERVERSION_telechips-subcore = "2"
LAYERDEPENDS_telechips-subcore = "telechips-core telechips-bsp"

LAYERSERIES_COMPAT_telechips-subcore = "zeus dunfell"

CLUSTER_PKG_NAME ?= "${@bb.utils.contains("DISTRO_FEATURES", "wayland", "wayland weston-init weston-examples", "qt-cluster", d)}"
RVC_SW_NUM ?= "0"
RVC_RECOVERY ?= "1"

SUBCORE_APPS ?= ""
RM_WORK_EXCLUDE += "telechips-subcore-image tc-rvc-app t-sound"
BUILDCFG_VARS_append = " SUBCORE_APPS"
```

## meta-subcore/conf/machine/tcc8030-sub.conf
```bitbake
#@TYPE: Machine
#@NAME: tcc803x Cortex-A7 single core
#@DESCRIPTION: Machine configuration for the Telechips Cortex-A7 single core

# Uncomment the following line to enable the hard floating point abi. Note that
# this breaks some binary libraries and 3D (neither of which ship with
# meta-yocto). For maximum compatibility, leave this disabled.
DEFAULTTUNE ?= "cortexa7hf-neon"

require conf/machine/include/tune-cortexa7.inc
require ${COREBASE}/meta-telechips-bsp/conf/machine/tcc-family.inc

SOC_FAMILY = "tcc803x:tcc8030-sub"

PREFERRED_PROVIDER_virtual/kernel = "linux-telechips"

TCC_ARCH_FAMILY = "tcc803x"
GST_ARCH_FAMILY_NAME = "TCC_803x"

INITRAMFS_IMAGE = ""
INITRAMFS_TASK = ""
INITRAMFS_IMAGE_BUNDLE = "0"

TC_BT_MODULE ??= ""
WIFI_MODULE ??= ""
LCD_TYPE ??= ""
TOUCH_SCREEN_TYPE ??= ""
SND_MACHINE_MODULE_NAME ??= ""
SERIAL_CONSOLES = "115200;ttyAMA0"
KERNEL_CONSOLE = "ttyAMA0"

CONFLICT_MACHINE_FEATURES = "ufs"

LINUX_VERSION_EXTENSION = "-tcc"
KBUILD_DEFCONFIG ??= "tcc803x_a7s_avm_defconfig"
KERNEL_DEVICETREE ?= "tcc/tcc8030-linux-a7s.dtb"
KERNEL_BASE_ADDR = "0x80000000"

EXTRA_CMDLINE_append = " quiet"
EXTRA_OMX_MACHINE_CONF = "--enable-h265dec"
EXTRA_IMAGEDEPENDS = ""
EXPECTED_ROOTFS_SIZE ?= "${@bb.utils.contains('SUBCORE_APPS', 'cluster', '35M', '22M', d)}"

UPDATE_KERNEL_NAME = "Image-tcc8030-sub.bin"
UPDATE_ROOTFS_NAME = "telechips-subcore-image-tcc8030-sub.cpio"
UPDATE_DTB_NAME = "tcc8030-linux-a7s.dtb"

INVITE_PLATFORM += "telechips-egl"

PREFERRED_PROVIDER_virtual/egl                                         = "telechips-egl"
PREFERRED_PROVIDER_virtual/libgles1                                    = "telechips-egl"
PREFERRED_PROVIDER_virtual/libgles2                                    = "telechips-egl"
PREFERRED_PROVIDER_virtual/mesa                                        = "telechips-egl"
PREFERRED_PROVIDER_libglapi                                            = "telechips-egl"
PREFERRED_PROVIDER_libgbm                                              = "telechips-egl"
PREFERRED_PROVIDER_libwayland-egl                                      = "telechips-egl"
```

## meta-subcore/conf/machine/tcc8059-sub.conf
```bitbake
#@TYPE: Machine
#@NAME: tcc8059 Cortex-A53 core
#@DESCRIPTION: Machine configuration for the Telechips Cortex-A53 core

ARCH_INC_PATH = "${@bb.utils.contains('ARCHITECTURE', 'arm', '${COREBASE}/meta-telechips-bsp/', '', d)}"

require ${ARCH_INC_PATH}conf/machine/include/tune-cortexa53.inc
require ${COREBASE}/meta-telechips-bsp/conf/machine/tcc-family.inc

SOC_FAMILY = "tcc805x:tcc8059-sub"

PREFERRED_PROVIDER_virtual/kernel = "linux-telechips"

TCC_ARCH_FAMILY = "tcc805x"
GST_ARCH_FAMILY_NAME = "TCC_805x"
BOOT_STORAGE ??= "emmc"
GPU_DRIVER_MODE ??= "${@bb.utils.contains_any("INVITE_PLATFORM", 'gpu-vz', 'host', 'native', d)}"

INITRAMFS_IMAGE = ""
INITRAMFS_TASK = ""
INITRAMFS_IMAGE_BUNDLE = "0"

TC_BT_MODULE ??= ""
WIFI_MODULE ??= ""
LCD_TYPE ??= ""
TOUCH_SCREEN_TYPE ??= ""
SND_MACHINE_MODULE_NAME ??= ""
SERIAL_CONSOLES = "115200;ttyAMA4"
KERNEL_CONSOLE = "ttyAMA4"

CONFLICT_MACHINE_FEATURES = "ufs"

LINUX_VERSION_EXTENSION = "-tcc"
KBUILD_DEFCONFIG ?= "tcc805x_a53_subcore_defconfig"
KERNEL_DEVICETREE ?= "tcc/tcc8059-linux-subcore_sv0.1.dtb"
KERNEL_BASE_ADDR = "0x40000000"

EXTRA_CMDLINE_append = " quiet"
EXTRA_CMDLINE_append = "${@bb.utils.contains('INVITE_PLATFORM', 'bootchart', ' init=/sbin/bootchartd', '', d)}"
EXTRA_OMX_MACHINE_CONF = "--enable-h265dec"
EXTRA_IMAGEDEPENDS = ""
EXPECTED_ROOTFS_SIZE ?= "25M"

UBOOT_NAME = "ca53_bl3"
UBOOT_MACHINE ?= "tcc805x_subcore_defconfig"
UBOOT_MAKE_TARGET = "tcc805x"
UBOOT_DEVICE_TREE = "tcc8059-subcore-evb_sv0.1"

UBOOT_SUFFIX = "rom"
UBOOT_IMAGE = "${UBOOT_NAME}-${MACHINE}-${PV}-${PR}.${UBOOT_SUFFIX}"
UBOOT_BINARY = "${UBOOT_NAME}.${UBOOT_SUFFIX}"
UBOOT_SYMLINK = "${UBOOT_NAME}-${MACHINE}.${UBOOT_SUFFIX}"

UPDATE_BOOTLOADER_NAME = "${UBOOT_NAME}.${UBOOT_SUFFIX}"
UPDATE_KERNEL_NAME = "tc-boot-${MACHINE}.img"
UPDATE_ROOTFS_NAME = "${IMAGE_LINK_NAME}.${DEFAULT_IMAGE_FSTYPE}"
UPDATE_DTB_NAME = "tcc8059-linux-subcore_sv0.1.dtb"

EXTRA_IMAGEDEPENDS += "u-boot-tcc"

CMDLINE = "'${EXTRA_CMDLINE}'"
```

## meta-update/conf/layer.conf
```bitbake
# We have a conf and classes directory, add to BBPATH
BBPATH .= ":${LAYERDIR}"

include meta-bsp/recipes-bsp/u-boot/u-boot-tcc.bb
# We have a recipes directory containing .bb and .bbappend files, add to BBFILES
BBFILES += "${LAYERDIR}/recipes-*/*.bb \
			${LAYERDIR}/recipes-*/*/*.bb \
			${LAYERDIR}/recipes-*/*/*.bbappend"

BBFILE_COLLECTIONS += "telechips-update"
BBFILE_PATTERN_telechips-update = "^${LAYERDIR}/"
BBFILE_PRIORITY_telechips-update = "8"


# This should only be incremented on significant changes that will
# cause compatibility issues with other layers
LAYERVERSION_telechips-update = "2"
LAYERDEPENDS_telechips-update = "telechips-core telechips-bsp"

LAYERSERIES_COMPAT_telechips-update = "dunfell"

#INVITE_PLATFORM_append = " fw-update"
RM_WORK_EXCLUDE += "tc-update-engine"
```
